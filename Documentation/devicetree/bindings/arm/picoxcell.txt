## Documentation/devicetree/bindings/arm/picoxcell.txt
```
Picochip picoXcell device tree bindings.
========================================

Required root node properties:
    - compatible:
	- "picochip,pc7302-pc3x3" : PC7302 development board with PC3X3 device.
	- "picochip,pc3x3" : picoXcell PC3X3 device based board.
	- "picochip,pc3x2" : picoXcell PC3X2 device based board.

Timers required properties:
    - compatible = "picochip,pc3x2-timer"
    - interrupts : The single IRQ line for the timer.
    - clock-freq : The frequency in HZ of the timer.
    - reg : The register bank for the timer.

Note: two timers are required - one for the scheduler clock and one for the
event tick/NOHZ.

VIC required properties:
    - compatible = "arm,pl192-vic-pair".
    - interrupt-controller.
    - reg : The register bank for the devices.  Picoxcell has two VIC's and the
      IRQ outputs are wire-OR'd together so we effectively have a combined
      controller that handles 64 IRQ's.  The first reg tuple is the register
      bank of the VIC that generates IRQ's 0->31 and the second tuple handles
      IRQ's 32->63.
    - #interrupt-cells : Must be 1.

Fixed Clocks
------------

Fixed clock required properties:
    - compatible = "fixed-clock".
    - clock-outputs : Comma separated list of names of clock outputs.
    - clock-frequency : The rate of the clock output in Hz.

Fixed clock optional properties:
    - ref-clock : The parent of the clock.  Must be in the form of <&phandle>,
      "output name".

PC3X3 Gateable Clocks
---------------------

PC3X3 clock gate required properties:
    - compatible = "picochip,pc3x3-clk-gate"
    - #address-cells : must be equal to 1.
    - #size-cells : must be equal to 0.
    - reg : The register bank for the clock gate control.
    - clock-outputs : Comma separated list of names of clock outputs.

The individual clock outputs are represented as child nodes of the clock gate.

PC3X3 gated clock required properties:
    - compatible : "picochip,pc3x3-gated-clk".
    - picochip,clk-disable-bit : The bit number in the clock gate control
      register that must be set to disable the clock output.
    - clock-frequency : The rate of the clock output in Hz.

PC3X3 gated clock optional properties:
    - ref-clock : The parent of the clock.  Must be in the form of <&phandle>,
      "output name".
    - picochip,clk-no-disable : Don't ever disable the clock.  This is required
      for memory controllers etc that don't have a driver associated with them.
```

## Documentation/devicetree/bindings/gpio/gpio-generic.txt
```
Generic MMIO GPIO controller

This binding allows lots of common GPIO controllers to use a generic GPIO
driver.  The top level GPIO node describes the registers for the controller
and high level properties such as endianness and register width.  Each bank in
the controller is represented as a child node.

Required properties:
- compatible : Must be one of:
  - "snps,dw-apb-gpio" : Synopsys DesignWare APB GPIO controller
- reg : The register window for the GPIO device.  If the device has multiple
  banks then this window should cover all of the banks.
- gpio-generic,reg-io-width : The width of the registers in the controller
  (in bytes).
- #address-cells : should be set to 1.
- #size-cells : should be set to 0.  The addresses of the child nodes are the
  bank numbers and the child nodes themselves represent the banks in the
  controller.

Optional properties:
- gpio-generic,big-endian : the registers are in big-endian byte ordering.
  If present then the first gpio in the controller occupies the MSB for
  each register.

Generic MMIO GPIO controller bank

Required properties:
- compatible : Must be one of:
  - "snps,dw-apb-gpio-bank" : Synopsys DesignWare APB GPIO controller bank
- gpio-controller : Marks the node as a GPIO controller.
- #gpio-cells : Should be two.  The first cell is the pin number and the
  second cell encodes optional flags (currently unused).
- gpio-generic,nr-gpio : The number of GPIO pins in the bank.
- regoffset-dat : The offset from the beginning of the controller for the
  "dat" register for this bank.  This register is read to get the value of the
  GPIO pins, and if there is no regoffset-set property then it is also used to
  set the value of the pins.

Optional properties:
- regoffset-set : The offset from the beginning of the controller for the
  "set" register for this bank.  If present then the GPIO values are set
  through this register (writing a 1 bit sets the GPIO high).  If there is no
  regoffset-clr property then writing a 0 bit to this register will set the
  pin to a low value.
- regoffset-clr : The offset from the beginning of the controller for the
  "clr" register for this bank.  Writing a 1 bit to this register will set the
  GPIO to a low output value.
- regoffset-dirout : The offset from the beginning of the controller for the
  "dirout" register for this bank.  Writing a 1 bit to this register sets the
  pin to be an output pin, writing a zero sets the pin to be an input.
- regoffset-dirin : The offset from the beginning of the controller for the
  "dirin" register for this bank.  Writing a 1 bit to this register sets the
  pin to be an input pin, writing a zero sets the pin to be an output.

Examples:

gpio: gpio@20000 {
	compatible = "snps,dw-apb-gpio";
	reg = <0x20000 0x1000>;
	#address-cells = <1>;
	#size-cells = <0>;
	gpio-generic,reg-io-width = <4>;

	banka: gpio-controller@0 {
		compatible = "snps,dw-apb-gpio";
		gpio-controller;
		#gpio-cells = <2>;
		gpio-generic,nr-gpio = <8>;

		regoffset-dat = <0x50>;
		regoffset-set = <0x00>;
		regoffset-dirout = <0x04>;
	};

	bankb: gpio-controller@1 {
		compatible = "snps,dw-apb-gpio";
		gpio-controller;
		#gpio-cells = <2>;
		gpio-generic,nr-gpio = <16>;

		regoffset-dat = <0x54>;
		regoffset-set = <0x0c>;
		regoffset-dirout = <0x10>;
	};
};
```

## arch/arm/mach-picoxcell/Kconfig
```kconfig
if ARCH_PICOXCELL

comment "Picochip SoC device support"

config PICOXCELL_PC3X2
	bool "Support PC3x2 devices"
	default y
	help
	  Include support for picoChip PC3x2 family of devices. This
	  includes PC302 and PC312.

config PICOXCELL_PC3X3
	bool "Support PC3x3 devices"
	default y
	help
	  Include support for picoChip PC3x3 family of devices. This includes
	  PC313, PC323 and PC333.

config PICOXCELL_PC30XX
	bool "Support PC30xx devices"
	default y
	help
	  Include support for picoChip PC30xx family of devices.

comment "Picochip picoXcell device configuration"

config PICOXCELL_STOP_WDT_IN_SUSPEND
	bool "Disable watchdog timer in suspend"
	depends on PICOXCELL_PC3X3 || PICOXCELL_PC30XX
	help
	  Say yes to pause the watchdog timer when in suspend mode on PC3X3
	  and PC30XX devices.  This will prevent the watchdog from rebooting
	  the device when suspend is entered.

config PC30XX_HW_NAND
	bool "Hardware NAND flash support for PC30XX"
	depends on PICOXCELL_PC30XX
	help
	  Say yes here to enable hardware NAND support for PC30XX devices.
	  The PC30XX devices contain a Denali NAND controller.  You will also
	  need to enable MTD_NAND_DENALI_MMIO to get the device driver built.

comment "Picochip picoXcell board selection"

config BOARD_PC7302
	bool "Support PC7302 Board"
	default y
	select PICOXCELL_HAVE_TSU
	depends on PICOXCELL_PC3X2 || PICOXCELL_PC3X3
	help
          Include support for the picoChip PC7302 platform. This platform is
	  can take any of the PC3X2 or PC3X3 devices and includes SPI NOR
	  flash, parallel NOR flash and NAND flash.

config PICOXCELL_HAVE_TSU
	bool

config PICOXCELL_UICC
	bool "Support for UART based UICC controller"
	depends on PICOXCELL_PC30XX
	help
	  Say Y here to include support for the UART based UICC controller.
	  This uses a UART along with some GPIO pins to allow userspace to
	  read/write UICC devices.  The protocol implementation is handled in
	  userspace.

endif
```

## drivers/clocksource/Kconfig
```kconfig
#
# Clocksource configuration
#

config DW_APB_TIMER
	bool

config DW_APB_TIMER_PLATFORM
	depends on HAVE_CLK
	select DW_APB_TIMER
	bool
```

## drivers/otp/Kconfig
```kconfig
#
# OTP memory configuration
#

menuconfig OTP
	bool "OTP memory support"
	help
	  Say Y here to support OTP (One Time Programmable) memory.  This
	  memory can commonly be used to store boot code, cryptographic keys
	  and other persistent data.  This memory is typically a few KBytes in
	  size and different devices may have different characteristics.  This
	  provides a character device interface to these devices to allow the
	  OTP to be programmed and read.

if OTP

config OTP_WRITE_ENABLE
	bool "Enable writing support of OTP pages"
	default n
	help
	  If you say Y here, you will enable support for writing of the
	  OTP pages.  This is dangerous by nature as you can only program
	  the pages once, so only enable this option when you actually
	  need it so as to not inadvertently clobber data.

	  If unsure, say N.

config OTP_PC3X3
	tristate "Enable support for Picochip PC3X3 OTP"
	depends on ARCH_PICOXCELL
	help
	  Say Y or M here to allow support for the OTP found in PC3X3 devices.
	  If you say M then the module will be called otp_pc3x3.

config BFIN_OTP
	tristate "Blackfin On-Chip OTP Memory Support"
	depends on BLACKFIN && (BF51x || BF52x || BF54x)
	default y
	help
	  If you say Y here, you will get support for a character device
	  interface into the One Time Programmable memory pages that are
	  stored on the Blackfin processor.  This will not get you access
	  to the secure memory pages however.  You will need to write your
	  own secure code and reader for that.

	  To compile this driver as a module, choose M here: the module
	  will be called bfin-otp.

	  If unsure, it is safe to say Y.

endif
```
